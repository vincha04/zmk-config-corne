## config/west.yml
```yaml
manifest:
  remotes:
    - name: vincha04
      url-base: https://github.com/vincha04
  projects:
    - name: zmk
      remote: vincha04
      revision: main
      import: app/west.yml
  self:
    path: config
```
